## conf/machine/include/x86/znver4.inc
```bitbake
DEFAULTTUNE = "znver4-64"
TUNEVALID[znver4] = "Enable AMD Zen V4 specific processor optimizations"
TUNE_CCARGS .= "${@bb.utils.contains('TUNE_FEATURES', 'znver4', ' -march=znver4 -mtune=znver4', '', d)}"

AVAILTUNES += "znver4-64"
TUNE_FEATURES:tune-znver4-64 = "${TUNE_FEATURES:tune-x86-64} znver4"
BASE_LIB:tune-znver4-64 = "lib64"
TUNE_PKGARCH:tune-znver4-64 = "znver4-64"
PACKAGE_EXTRA_ARCHS:tune-znver4-64 = "${PACKAGE_EXTRA_ARCHS:tune-x86-64} znver4-64"
QEMU_EXTRAOPTIONS:tune-znver4-64 = " -cpu EPYC,check=false"

COMPATIBLE_MACHINE:znver4 = "^(znver4|genericx86-64)$"
```

## conf/machine/include/x86/znver5.inc
```bitbake
DEFAULTTUNE = "znver5-64"
TUNEVALID[znver5] = "Enable AMD Zen V5 specific processor optimizations"
TUNE_CCARGS .= "${@bb.utils.contains('TUNE_FEATURES', 'znver5', ' -march=znver5 -mtune=znver5', '', d)}"

AVAILTUNES += "znver5-64"
TUNE_FEATURES:tune-znver5-64 = "${TUNE_FEATURES:tune-x86-64} znver5"
BASE_LIB:tune-znver5-64 = "lib64"
TUNE_PKGARCH:tune-znver5-64 = "znver5-64"
PACKAGE_EXTRA_ARCHS:tune-znver5-64 = "${PACKAGE_EXTRA_ARCHS:tune-x86-64} znver5-64"
QEMU_EXTRAOPTIONS:tune-znver5-64 = " -cpu EPYC,check=false"

COMPATIBLE_MACHINE:znver5 = "^(znver5|genericx86-64)$"
```

## conf/machine/mahler.conf
```bitbake
# AMD Ryzen 9 7950X3D (Q1'23)
require conf/machine/include/x86/base.inc
require conf/machine/include/x86/znver4.inc

COMPATIBLE_MACHINE:mahler = "^(mahler|genericx86-64)$"

# FIXME qemu-user does not implement avx512f or avx512vl
# This prevents building DISTRO=house
MACHINE_FEATURES:remove = "qemu-usermode"
```

## conf/machine/minimal-pc.conf
```bitbake
# Minimal MACHINE restricted to its kernel INITRD
require conf/machine/include/x86/base.inc
require conf/machine/include/x86/universal-v2.inc

COMPATIBLE_MACHINE:minimal-pc = "^(minimal-pc|universal-v2|genericx86-64)$"
```

## conf/machine/nuc11pahi3.conf
```bitbake
# NUC 11PAHi3 (Q3'23) / Intel i3-1115G4 (Q3'20)
require conf/machine/include/x86/base.inc
require conf/machine/include/x86/tigerlake.inc

COMPATIBLE_MACHINE:nuc11pahi3 = "^(nuc11pahi3|genericx86-64)$"

# FIXME qemu-user does not implement avx512f or avx512vl
# This prevents building DISTRO=house
MACHINE_FEATURES:remove = "qemu-usermode"
```

## conf/machine/nuc5cpyb.conf
```bitbake
# NUC 5CPYB (Q3'15) / Intel Celeron N3050 (Q1'16)
require conf/machine/include/x86/base.inc
require conf/machine/include/x86/silvermont.inc

COMPATIBLE_MACHINE:nuc5cpyb = "^(nuc5cpyb|genericx86-64)$"
```

## conf/machine/nucd54250wyb.conf
```bitbake
# NUC D54250WYB (Q4'13) / Intel i5-4250U (Q3'13)
require conf/machine/include/x86/base.inc
require conf/machine/include/x86/haswell.inc

COMPATIBLE_MACHINE:nucd54250wyb = "^(nucd54250wyb|genericx86-64)$"
```

## conf/machine/nucde3815tykh.conf
```bitbake
# NUC DE3815TYKH (Q2'14) / Intel Atom E3815 (Q4'13)
require conf/machine/include/x86/base.inc
require conf/machine/include/x86/silvermont.inc

COMPATIBLE_MACHINE:nucde3815tykh = "^(nucde3815tykh|genericx86-64)$"
```

## conf/machine/telemann.conf
```bitbake
# AMD Ryzen 9 6900HX (Q1'22)
require conf/machine/include/x86/base.inc
require conf/machine/include/x86/znver3.inc

COMPATIBLE_MACHINE:telemann = "^(telemann|genericx86-64)$"
```

## conf/machine/universal-pc-v2.conf
```bitbake
# Universal MACHINE which supports x86-64-v2+ CPUs
require conf/machine/include/x86/base.inc
require conf/machine/include/x86/universal-v2.inc

COMPATIBLE_MACHINE:universal-pc-v2 = "^(universal-pc-v2|genericx86-64)$"

MACHINE_EXTRA_RRECOMMENDS:append = " \
	kernel-modules \
	linux-firmware \
	"
```

## conf/machine/universal-pc-v3.conf
```bitbake
# Universal MACHINE which supports x86-64-v3+ CPUs
require conf/machine/include/x86/base.inc
require conf/machine/include/x86/universal-v3.inc

COMPATIBLE_MACHINE:universal-pc-v3 = "^(universal-pc-v3|genericx86-64)$"

MACHINE_EXTRA_RRECOMMENDS:append = " \
	kernel-modules \
	linux-firmware \
	"
```

## conf/machine/universal-pc-v4.conf
```bitbake
# Universal MACHINE which supports x86-64-v4+ CPUs
require conf/machine/include/x86/base.inc
require conf/machine/include/x86/universal-pc-v4.inc

COMPATIBLE_MACHINE:universal-pc-v4 = "^(universal-pc-v4|genericx86-64)$"

MACHINE_EXTRA_RRECOMMENDS:append = " \
	kernel-modules \
	linux-firmware \
	"
```

## conf/machine/xps9300.conf
```bitbake
# Intel i7-1065G7 (Q3'19)
require conf/machine/include/x86/base.inc
require conf/machine/include/x86/icelake-client.inc

COMPATIBLE_MACHINE:xps9300 = "^(xps9300|genericx86-64)$"

# FIXME qemu-user does not implement avx512f or avx512vl
# This prevents building DISTRO=house
MACHINE_FEATURES:remove = "qemu-usermode"
```

## conf/machine/xps9340.conf
```bitbake
# Intel Ultra 7 155H (Q4'23)
require conf/machine/include/x86/base.inc
require conf/machine/include/x86/alderlake.inc

COMPATIBLE_MACHINE:xps9340 = "^(xps9340|genericx86-64)$"

# FIXME qemu-user does not implement avx512f or avx512vl
# This prevents building DISTRO=house
MACHINE_FEATURES:remove = "qemu-usermode"
```
