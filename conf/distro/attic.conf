## conf/distro/attic.conf
```bitbake
DISTRO ?= "attic"
DISTRO_NAME = "Attic Linux"
DISTRO_VERSION = "1.0"
DISTRO_CODENAME = "Assiduous Armadillo"
DISTRO_FEATURES = "ipv4 ipv6 usbhost"

FULL_OPTIMIZATION = "-Os"
TCLIBC = "musl"
#TOOLCHAIN = "clang"
#TC_CXX_RUNTIME = "llvm"
#CLANGSDK = "1"

INIT_MANAGER = "mdev-busybox"
VIRTUAL-RUNTIME_base-utils-syslog = "busybox-syslog"
VIRTUAL-RUNTIME_dev_manager = "busybox-mdev"
VIRTUAL-RUNTIME_init_manager = "busybox"
VIRTUAL-RUNTIME_initscripts = "initscripts"
VIRTUAL-RUNTIME_login_manager = "busybox"
VIRTUAL-RUNTIME_syslog = "busybox-syslog"

USE_NLS = "no"
IMAGE_LINGUAS = " "
ENABLE_WIDEC:class-native = "true"
ENABLE_WIDEC = "false"

EFI_PROVIDER = "grub-efi"
INITRAMFS_IMAGE = "attic-initrd-image"
INITRAMFS_IMAGE_BUNDLE = "1"

require conf/distro/base.inc
require conf/distro/include/gcsections.inc
```

## conf/distro/base.inc
```bitbake
# All DISTROs

SDK_VENDOR = "-${DISTRO}sdk"
SDK_VERSION = "${DISTRO_VERSION}"
SDK_VERSION[vardepvalue] = "${SDK_VERSION}"
SDK_NAME = "${DISTRO}-${TCLIBC}-${SDKMACHINE}-${IMAGE_BASENAME}-${TUNE_PKGARCH}-${MACHINE}"
SDKPATHINSTALL = "/opt/${DISTRO}/${SDK_VERSION}"
TARGET_VENDOR = "-${DISTRO}"

FILESYSTEM_PERMS_TABLES:remove = "files/fs-perms-volatile-log.txt"
ROOT_HOME = "/root"

BB_HASHSERVE = "auto"
BB_SIGNATURE_HANDLER = "OEEquivHash"
BB_STRICT_CHECKSUM = "1"
BBINCLUDELOGS = "yes"
OEINCLUDELOGS = "yes"

INHERIT += "create-spdx"
CONNECTIVITY_CHECK_URIS = ""
QA_LOGFILE = "${TMPDIR}/qa.log"
NOERROR_QA = "buildpaths patch-status"
ERROR_QA:remove := "${NOERROR_QA}"
WARN_QA:append := " ${NOERROR_QA}"

PREFERRED_PROVIDER_llvm = "clang"
PREFERRED_PROVIDER_llvm-native = "clang-native"
PREFERRED_PROVIDER_nativesdk-llvm = "nativesdk-clang"
PROVIDES:pn-clang = "llvm"
PROVIDES:pn-clang-native = "llvm-native"
PROVIDES:pn-nativesdk-clang = "nativesdk-llvm"

# FIXME: Because I build with linux-next somtimes, I want control over versions,
# and I can't find a better way to do that than duplicating a bit of the recipes
# from oe-core... see linux-upstream-headers.bb and strace-upstream.bb.
BBMASK:append = " linux-libc-headers strace"

# FIXME: Force the user to acknowledge this somehow...
LICENSE_FLAGS_ACCEPTED:append = " commercial_ffmpeg"
```

## conf/distro/basement.conf
```bitbake
DISTRO ?= "basement"
DISTRO_NAME = "Basement Linux"
DISTRO_VERSION = "1.0"
DISTRO_CODENAME = "Bodacious Barracuda"
DISTRO_FEATURES = ""

FULL_OPTIMIZATION = "-Oz"
TCLIBC = "musl"

INIT_MANAGER = "none"
VIRTUAL-RUNTIME_init_manager = ""
VIRTUAL-RUNTIME_login_manager = ""
VIRTUAL-RUNTIME_dev_manager = ""
VIRTUAL-RUNTIME_initscripts = ""
VIRTUAL-RUNTIME_base-utils-syslog = ""
VIRTUAL-RUNTIME_syslog = ""

USE_NLS = "no"
IMAGE_LINGUAS = " "
ENABLE_WIDEC:class-native = "true"
ENABLE_WIDEC = "false"

EFI_PROVIDER = "grub-efi"
INITRAMFS_IMAGE = "minimal-initramfs-image"
INITRAMFS_IMAGE_BUNDLE = "1"

require conf/distro/base.inc
require conf/distro/include/gcsections.inc
```

## conf/distro/common.inc
```bitbake
# Self-hosting DISTROs

PACKAGE_CLASSES = "package_ipk"

BUILD_CFLAGS:append:pn-binutils-native = " -pie -fpie"

PREFERRED_PROVIDER_virtual/base-utils = "packagegroup-core-base-utils"
VIRTUAL-RUNTIME_base-utils-hwclock = "util-linux-hwclock"
VIRTUAL-RUNTIME_keymaps = "keymaps"
VIRTUAL-RUNTIME_login_manager = "shadow-base"
VIRTUAL-RUNTIME_vim = "vim"

DEFAULT_IMAGE_LINGUAS = "en-us"
DEFAULT_IMAGE_LINGUAS:libc-glibc = "en-us c"

GLIBC_GENERATE_LOCALES = "all"
ENABLE_BINARY_LOCALE_GENERATION = "1"

LOCALE_UTF8_IS_DEFAULT = "1"
LOCALE_UTF8_IS_DEFAULT:class-nativesdk = "0"
LOCALE_UTF8_ONLY = "0"

require conf/distro/base.inc
```

## conf/distro/garage.conf
```bitbake
DISTRO ?= "garage"
DISTRO_NAME = "Garage Linux"
DISTRO_VERSION = "1.0"
DISTRO_CODENAME = "Gregarious Gorilla"
DISTRO_FEATURES:remove = "systemd"
DISTRO_FEATURES = " \
	acl \
	ipsec \
	ipv4 \
	ipv6 \
	keyboard \
	ldconfig \
	nls \
	opengl \
	pci \
	sysvinit \
	usbgadget \
	usbhost \
	usrmerge \
	vfat \
	xattr \
	x11 \
	"

INIT_MANAGER = "sysvinit"
VIRTUAL-RUNTIME_base-utils-syslog = "rsyslog"
VIRTUAL-RUNTIME_dev_manager = "udev"
VIRTUAL-RUNTIME_init_manager = "sysvinit"
VIRTUAL-RUNTIME_initscripts = "initscripts"
VIRTUAL-RUNTIME_syslog = "rsyslog"

EFI_PROVIDER = "grub-efi"
INITRAMFS_IMAGE = "garage-initrd-image"
INITRAMFS_IMAGE_BUNDLE = "1"

# FIXME: Prevent WKS from adding this somehow...
APPEND:remove = "root=PARTLABEL=root"

require conf/distro/common.inc
```

## conf/distro/house.conf
```bitbake
DISTRO ?= "house"
DISTRO_NAME = "House Linux"
DISTRO_VERSION = "1.0"
DISTRO_CODENAME = "Haphazard Hippopotamus"
DISTRO_FEATURES_BACKFILL_CONSIDERED = "sysvinit"
DISTRO_FEATURES:remove = "sysvinit"
DISTRO_FEATURES = " \
	3g \
	acl \
	alsa \
	bluetooth \
	gobject-introspection-data \
	ipsec \
	ipv4 \
	ipv6 \
	keyboard \
	ldconfig \
	nfc \
	nfs \
	nls \
	opengl \
	overlayfs \
	pam \
	pci \
	pipewire \
	polkit \
	pulseaudio \
	seccomp \
	smbfs \
	systemd \
	usbgadget \
	usbhost \
	usrmerge \
	vfat \
	vulkan \
	wayland \
	xattr \
	x11 \
	zeroconf \
	"

INIT_MANAGER = "systemd"
VIRTUAL-RUNTIME_base-utils-syslog = ""
VIRTUAL-RUNTIME_dev_manager = "systemd"
VIRTUAL-RUNTIME_graphical_init_manager = "gdm"
VIRTUAL-RUNTIME_init_manager = "systemd"
VIRTUAL-RUNTIME_initscripts = "systemd-compat-units"
VIRTUAL-RUNTIME_syslog = ""

EFI_PROVIDER = "systemd-boot"
INITRAMFS_IMAGE = "house-initrd-image"
INITRAMFS_IMAGE_BUNDLE = "0"

require conf/distro/common.inc
```

## conf/layer.conf
```bitbake
BBPATH .= ":${LAYERDIR}"

BBFILES += " \
	${LAYERDIR}/recipes-*/*/*.bb \
	${LAYERDIR}/recipes-*/*/*.bbappend \
	"

BBFILE_COLLECTIONS += "meta-house"
BBFILE_PATTERN_meta-house = "^${LAYERDIR}/"
BBFILE_PRIORITY_meta-house = "9"

LAYERDEPENDS_meta-house = "core"
LAYERSERIES_COMPAT_meta-house = "scarthgap walnascar whinlatter wrynose"
```

## conf/machine/bach.conf
```bitbake
# Intel Xeon E-2124 (Q3'18)
require conf/machine/include/x86/base.inc
require conf/machine/include/x86/skylake.inc

COMPATIBLE_MACHINE:bach = "^(bach|genericx86-64)$"
```

## conf/machine/beethoven.conf
```bitbake
# AMD Ryzen 9 9900X3D (Q1'25)
require conf/machine/include/x86/base.inc
require conf/machine/include/x86/znver5.inc

COMPATIBLE_MACHINE:beethoven = "^(beethoven|genericx86-64)$"

# FIXME qemu-user does not implement avx512f or avx512vl
# This prevents building DISTRO=house
MACHINE_FEATURES:remove = "qemu-usermode"
```

## conf/machine/bmaxb1.conf
```bitbake
# Bmax B1 Mini Pro / Intel Celeron N4000 (Q4'17)
require conf/machine/include/x86/base.inc
require conf/machine/include/x86/goldmont-plus.inc

COMPATIBLE_MACHINE:bmaxb1 = "^(bmaxb1|genericx86-64)$"

# FIXME qemu-user does not implement avx512f or avx512vl
# This prevents building DISTRO=house
MACHINE_FEATURES:remove = "qemu-usermode"
```

## conf/machine/brahms.conf
```bitbake
# Intel i7-8700 (Q4'17)
require conf/machine/include/x86/base.inc
require conf/machine/include/x86/skylake.inc

COMPATIBLE_MACHINE:brahms = "^(brahms|genericx86-64)$"
```

## conf/machine/handel.conf
```bitbake
# Intel i7-4770 (Q2'13)
require conf/machine/include/x86/base.inc
require conf/machine/include/x86/haswell.inc

COMPATIBLE_MACHINE:handel = "^(handel|genericx86-64)$"
```

## conf/machine/haydn.conf
```bitbake
# Intel Xeon E-2136 (Q3'18)
require conf/machine/include/x86/base.inc
require conf/machine/include/x86/skylake.inc

COMPATIBLE_MACHINE:haydn = "^(haydn|genericx86-64)$"
```

## conf/machine/include/x86/alderlake.inc
```bitbake
DEFAULTTUNE = "alderlake-64"
TUNEVALID[alderlake] = "Enable Alder Lake specific processor optimizations"
TUNE_CCARGS .= "${@bb.utils.contains('TUNE_FEATURES', 'alderlake', ' -march=alderlake -mtune=alderlake', '', d)}"

AVAILTUNES += "alderlake-64"
TUNE_FEATURES:tune-alderlake-64 = "${TUNE_FEATURES:tune-x86-64} alderlake"
BASE_LIB:tune-alderlake-64 = "lib64"
TUNE_PKGARCH:tune-alderlake-64 = "alderlake-64"
PACKAGE_EXTRA_ARCHS:tune-alderlake-64 = "${PACKAGE_EXTRA_ARCHS:tune-x86-64} alderlake-64"
QEMU_EXTRAOPTIONS:tune-alderlake-64 = " -cpu GraniteRapids,check=false"

COMPATIBLE_MACHINE:alderlake = "^(alderlake|genericx86-64)$"
```

## conf/machine/include/x86/base.inc
```bitbake
require conf/machine/include/x86/x86-base.inc
require conf/machine/include/x86/arch-x86.inc

PREFERRED_PROVIDER_virtual/kernel = "linux-upstream"

MACHINE_FEATURES:append = " \
	acpi \
	alsa \
	bluetooth \
	efi \
	keyboard \
	numa \
	pcbios \
	pci \
	qemu-usermode \
	rtc \
	screen \
	usbgadget \
	usbhost \
	vfat \
	wifi \
	"
```

## conf/machine/include/x86/goldmont-plus.inc
```bitbake
DEFAULTTUNE = "goldmont-plus-64"
TUNEVALID[goldmont-plus] = "Enable goldmont-plus specific processor optimizations"
TUNE_CCARGS .= "${@bb.utils.contains('TUNE_FEATURES', 'goldmont-plus', ' -march=goldmont-plus -mtune=goldmont-plus', '', d)}"

AVAILTUNES += "goldmont-plus-64"
TUNE_FEATURES:tune-goldmont-plus-64 = "${TUNE_FEATURES:tune-x86-64} goldmont-plus"
BASE_LIB:tune-goldmont-plus-64 = "lib64"
TUNE_PKGARCH:tune-goldmont-plus-64 = "goldmont-plus-64"
PACKAGE_EXTRA_ARCHS:tune-goldmont-plus-64 = "${PACKAGE_EXTRA_ARCHS:tune-x86-64} goldmont-plus-64"
QEMU_EXTRAOPTIONS:tune-goldmont-plus-64 = " -cpu Cooperlake,check=false"

COMPATIBLE_MACHINE:goldmont-plus = "^(goldmont-plus|genericx86-64)$"
```

## conf/machine/include/x86/haswell.inc
```bitbake
DEFAULTTUNE = "haswell-64"
TUNEVALID[haswell] = "Enable haswell specific processor optimizations"
TUNE_CCARGS .= "${@bb.utils.contains('TUNE_FEATURES', 'haswell', ' -march=haswell -mtune=haswell', '', d)}"

AVAILTUNES += "haswell-64"
TUNE_FEATURES:tune-haswell-64 = "${TUNE_FEATURES:tune-x86-64} haswell"
BASE_LIB:tune-haswell-64 = "lib64"
TUNE_PKGARCH:tune-haswell-64 = "haswell-64"
PACKAGE_EXTRA_ARCHS:tune-haswell-64 = "${PACKAGE_EXTRA_ARCHS:tune-x86-64} haswell-64"
QEMU_EXTRAOPTIONS:tune-haswell-64 = " -cpu Haswell,check=false"

COMPATIBLE_MACHINE:haswell = "^(haswell|genericx86-64)$"
```

## conf/machine/include/x86/icelake-client.inc
```bitbake
DEFAULTTUNE = "icelake-client-64"
TUNEVALID[icelake-client] = "Enable Ice Lake specific processor optimizations"
TUNE_CCARGS .= "${@bb.utils.contains('TUNE_FEATURES', 'icelake-client', ' -march=icelake-client -mtune=icelake-client', '', d)}"

AVAILTUNES += "icelake-client-64"
TUNE_FEATURES:tune-icelake-client-64 = "${TUNE_FEATURES:tune-x86-64} icelake-client"
BASE_LIB:tune-icelake-client-64 = "lib64"
TUNE_PKGARCH:tune-icelake-client-64 = "icelake-client-64"
PACKAGE_EXTRA_ARCHS:tune-icelake-client-64 = "${PACKAGE_EXTRA_ARCHS:tune-x86-64} icelake-client-64"
QEMU_EXTRAOPTIONS:tune-icelake-client-64 = " -cpu Icelake-Server,check=false"

COMPATIBLE_MACHINE:icelake-client = "^(icelake-client|genericx86-64)$"
```

## conf/machine/include/x86/silvermont.inc
```bitbake
DEFAULTTUNE = "silvermont-64"
TUNEVALID[silvermont] = "Enable Silvermont specific processor optimizations"
TUNE_CCARGS .= "${@bb.utils.contains('TUNE_FEATURES', 'silvermont', ' -march=silvermont -mtune=silvermont', '', d)}"

AVAILTUNES += "silvermont-64"
TUNE_FEATURES:tune-silvermont-64 = "${TUNE_FEATURES:tune-x86-64} silvermont"
BASE_LIB:tune-silvermont-64 = "lib64"
TUNE_PKGARCH:tune-silvermont-64 = "silvermont-64"
PACKAGE_EXTRA_ARCHS:tune-silvermont-64 = "${PACKAGE_EXTRA_ARCHS:tune-x86-64} silvermont-64"
QEMU_EXTRAOPTIONS:tune-silvermont-64 = " -cpu Denverton,check=false"

COMPATIBLE_MACHINE:silvermont = "^(silvermont|genericx86-64)$"
```

## conf/machine/include/x86/skylake.inc
```bitbake
DEFAULTTUNE = "skylake-64"
TUNEVALID[skylake] = "Enable skylake specific processor optimizations"
TUNE_CCARGS .= "${@bb.utils.contains('TUNE_FEATURES', 'skylake', ' -march=skylake -mtune=skylake', '', d)}"

AVAILTUNES += "skylake-64"
TUNE_FEATURES:tune-skylake-64 = "${TUNE_FEATURES:tune-x86-64} skylake"
BASE_LIB:tune-skylake-64 = "lib64"
TUNE_PKGARCH:tune-skylake-64 = "skylake-64"
PACKAGE_EXTRA_ARCHS:tune-skylake-64 = "${PACKAGE_EXTRA_ARCHS:tune-x86-64} skylake-64"
QEMU_EXTRAOPTIONS:tune-skylake-64 = " -cpu Skylake-Server,check=false"

COMPATIBLE_MACHINE:skylake = "^(skylake|genericx86-64)$"
```

## conf/machine/include/x86/tigerlake.inc
```bitbake
DEFAULTTUNE = "tigerlake-64"
TUNEVALID[tigerlake] = "Enable Tiger Lake specific processor optimizations"
TUNE_CCARGS .= "${@bb.utils.contains('TUNE_FEATURES', 'tigerlake', ' -march=tigerlake -mtune=tigerlake', '', d)}"

AVAILTUNES += "tigerlake-64"
TUNE_FEATURES:tune-tigerlake-64 = "${TUNE_FEATURES:tune-x86-64} tigerlake"
BASE_LIB:tune-tigerlake-64 = "lib64"
TUNE_PKGARCH:tune-tigerlake-64 = "tigerlake-64"
PACKAGE_EXTRA_ARCHS:tune-tigerlake-64 = "${PACKAGE_EXTRA_ARCHS:tune-x86-64} tigerlake-64"
QEMU_EXTRAOPTIONS:tune-tigerlake-64 = " -cpu Icelake-Server,check=false"

COMPATIBLE_MACHINE:tigerlake = "^(tigerlake|genericx86-64)$"
```

## conf/machine/include/x86/universal-v2.inc
```bitbake
DEFAULTTUNE = "universal-v2-64"
TUNEVALID[universal-v2] = "Universal x86-64-v2 optimizations"
TUNE_CCARGS .= "${@bb.utils.contains('TUNE_FEATURES', 'universal-v2', ' -march=x86-64-v2', '', d)}"

AVAILTUNES += "universal-v2-64"
TUNE_FEATURES:tune-universal-v2-64 = "${TUNE_FEATURES:tune-x86-64} universal-v2"
BASE_LIB:tune-universal-v2-64 = "lib64"
TUNE_PKGARCH:tune-universal-v2-64 = "universal-v2-64"
PACKAGE_EXTRA_ARCHS:tune-universal-v2-64 = "${PACKAGE_EXTRA_ARCHS:tune-x86-64} universal-v2-64"
QEMU_EXTRAOPTIONS:tune-universal-v2-64 = " -cpu Nehalem,check=false"

COMPATIBLE_MACHINE:universal-v2 = "^(universal-v2|genericx86-64)$"
```

## conf/machine/include/x86/universal-v3.inc
```bitbake
DEFAULTTUNE = "universal-v3-64"
TUNEVALID[universal-v3] = "Universal x86-64-v3 optimizations"
TUNE_CCARGS .= "${@bb.utils.contains('TUNE_FEATURES', 'universal-v3', ' -march=x86-64-v3', '', d)}"

AVAILTUNES += "universal-v3-64"
TUNE_FEATURES:tune-universal-v3-64 = "${TUNE_FEATURES:tune-x86-64} universal-v3"
BASE_LIB:tune-universal-v3-64 = "lib64"
TUNE_PKGARCH:tune-universal-v3-64 = "universal-v3-64"
PACKAGE_EXTRA_ARCHS:tune-universal-v3-64 = "${PACKAGE_EXTRA_ARCHS:tune-x86-64} universal-v3-64"
QEMU_EXTRAOPTIONS:tune-universal-v3-64 = " -cpu Skylake-Client,check=false"

COMPATIBLE_MACHINE:universal-v3 = "^(universal-v3|genericx86-64)$"
```

## conf/machine/include/x86/universal-v4.inc
```bitbake
DEFAULTTUNE = "universal-v4-64"
TUNEVALID[universal-v4] = "Universal x86-64-v4 optimizations"
TUNE_CCARGS .= "${@bb.utils.contains('TUNE_FEATURES', 'universal-v4', ' -march=x86-64-v4', '', d)}"

AVAILTUNES += "universal-v4-64"
TUNE_FEATURES:tune-universal-v4-64 = "${TUNE_FEATURES:tune-x86-64} universal-v4"
BASE_LIB:tune-universal-v4-64 = "lib64"
TUNE_PKGARCH:tune-universal-v4-64 = "universal-v4-64"
PACKAGE_EXTRA_ARCHS:tune-universal-v4-64 = "${PACKAGE_EXTRA_ARCHS:tune-x86-64} universal-v4-64"
QEMU_EXTRAOPTIONS:tune-universal-v4-64 = " -cpu SapphireRapids,check=false"

COMPATIBLE_MACHINE:universal-v4 = "^(universal-v4|genericx86-64)$"
```

## conf/machine/include/x86/znver3.inc
```bitbake
DEFAULTTUNE = "znver3-64"
TUNEVALID[znver3] = "Enable AMD Zen V3 specific processor optimizations"
TUNE_CCARGS .= "${@bb.utils.contains('TUNE_FEATURES', 'znver3', ' -march=znver3 -mtune=znver3', '', d)}"

AVAILTUNES += "znver3-64"
TUNE_FEATURES:tune-znver3-64 = "${TUNE_FEATURES:tune-x86-64} znver3"
BASE_LIB:tune-znver3-64 = "lib64"
TUNE_PKGARCH:tune-znver3-64 = "znver3-64"
PACKAGE_EXTRA_ARCHS:tune-znver3-64 = "${PACKAGE_EXTRA_ARCHS:tune-x86-64} znver3-64"
QEMU_EXTRAOPTIONS:tune-znver3-64 = " -cpu EPYC,check=false"

COMPATIBLE_MACHINE:znver3 = "^(znver3|genericx86-64)$"
```
